## ik-bus-protocol-implementation/ibus/Kconfig
```kconfig
#
# Instrumentation and body communication buses (I and K bus)
#

config IBUS
	depends on NET
	tristate "I/K-bus"
	---help---
	  Instrumentation and body buses are a communication bus for
	  BMW automotive. It is a half-duplex area network connected 
	  control units over one wire.

	  If you want I/K-bus support you should say Y here and also
	  to the specific driver for your controller(s) below.
```

## slibus-driver/ibus/Kconfig
```kconfig
menu "I/K-bus device drivers"

config IBUS_SLIBUS
	tristate "I/K serial line net device"
	depends on TTY
	---help---
	  I/K-bus driver for serial interface that are attached via serial
	  lines.

endmenu
```
